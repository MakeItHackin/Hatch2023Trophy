
//////////////////////////////////////////////////////////////////////////////////////////////////
//////////  2023 Hudson Alpha Tech Challenge - TROPHY DEMO CODE - BY MakeItHackin
//////////////////////////////////////////////////////////////////////////////////////////////////


/* 
  IF YOU HAVE ANY QUESTIONS OR COMMENTS, FEEL FREE TO INITIATE AN ISSUE ON GITHUB.  I PLAN TO ADD ADDITIONAL COMMENTS IN THE CODE, AND MAYBE SOME MORE FEATURES!
  
  ALL LIBRARIES FOR COMPONENTS WILL BE INCLUDED IN GITHUB LINK, SO FEEL FREE TO TINKER AROUND!
  https://github.com/MakeItHackin/Hatch2023Trophy
 */


/*
  LIBRARIES FOR NEOPIXELS WERE DERIVED FROM LIBRARIES BY ADAFRUIT

  Adafruit invests time and resources providing this open source code,
  please support Adafruit and open-source hardware by purchasing
  products from Adafruit!
  Written by Limor Fried/Ladyada for Adafruit Industries.
  MIT license, all text above must be included in any redistribution
  
 */


////////////////////////////////////////////////////////////////
//////////  ATTINY 85 PINOUT
////////////////////////////////////////////////////////////////

 
/*
  
  GND - BATTERY NEGATIVE TERMINAL
  VCC - BATTERY POSITIVE TERMINAL
  PBO - I2C BUS - SDA
  PB1 - NEOPIXEL OUT
  PB2 - I2C BUS - SCL
  PB3 - LIGHT SENSOR INPUT
  PB4 - BUTTON INPUT
  PB5 - RESET BUTTON
  
 */


////////////////////////////////////////////////////////////////
//////////  VARIABLES AND LIBRARIES
////////////////////////////////////////////////////////////////

#include "TinyWireM.h" // USED FOR I2C CAPABILITIES
#include "TinyOzOLED.h" // USED FOR THE SSD1306 OLED SCREEN

#include <tinyNeoPixel_Static.h>  // USED FOR NEOPIXELS
#define PIN 1
// Parameter 1 = number of pixels in strip
// Parameter 2 = Arduino pin number (most are valid)
// Parameter 3 = pixel type flags, add together as needed:
//   NEO_GRB     Pixels are wired for GRB bitstream (most NeoPixel products)
//   NEO_RGB     Pixels are wired for RGB bitstream (v1 FLORA pixels, not v2)
// Parameter 4 = array to store pixel data in      
#define NUMPIXELS 16
// Since this is for the static version of the library, we need to supply the pixel array
// This saves space by eliminating use of malloc() and free(), and makes the RAM used for
// the frame buffer show up when the sketch is compiled.
byte pixels[NUMPIXELS * 3];
// When we setup the NeoPixel library, we tell it how many pixels, and which pin to use to send signals.
// Note that for older NeoPixel strips you might need to change the third parameter--see the strandtest
// example for more information on possible values. Finally, for the 4th argument we pass the array we
// defined above.
tinyNeoPixel strip = tinyNeoPixel(NUMPIXELS, PIN, NEO_GRB, pixels);
// IMPORTANT: To reduce NeoPixel burnout risk, add 1000 uF capacitor across
// pixel power leads, add 300 - 500 Ohm resistor on first pixel's data input
// and minimize distance between Arduino and first pixel.  Avoid connecting
// on a live circuit...if you must, connect GND first.



#define BUTTON_PIN   4    // Digital IO pin connected to the button.  This will be
                          // driven with a pull-up resistor so the switch should
                          // pull the pin to ground momentarily.  On a high -> low
                          // transition the button press logic will execute.

                          

#define LIGHT_SENSOR_PIN A3  // THIS IS PB3, BUT MUST LABEL IT A3 IN ORDER FOR THE ANALOG FUNCTIONS TO WORK
int lightSensorValue = 0;






const unsigned char HudsonAlphaBitmap [] PROGMEM = {
  0x00, 0x00, 0x00, 0x00, 0x00, 0x00, 0x00, 0x00, 0x00, 0x00, 0x00, 0x00, 0x00, 0x00, 0x00, 0x00, 
  0x00, 0x00, 0x00, 0x00, 0x00, 0x00, 0x00, 0x00, 0x00, 0x00, 0x00, 0x00, 0x00, 0x00, 0x00, 0x00, 
  0x00, 0x00, 0x00, 0x00, 0x00, 0x00, 0x00, 0x00, 0x00, 0x00, 0x00, 0x00, 0x00, 0x00, 0x00, 0x00, 
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  0x00, 0x00, 0x00, 0x00, 0x00, 0x00, 0x00, 0x00, 0x00, 0x00, 0x00, 0x00, 0x00, 0x00, 0x00, 0x00
};


// 'hatch2023', 128x32px
const unsigned char HATCH2023Bitmap [] PROGMEM = {
  0xc0, 0xc0, 0xc0, 0xc0, 0xc0, 0x00, 0x00, 0x00, 0x00, 0x00, 0x00, 0x00, 0x00, 0x00, 0x00, 0x00, 
  0x00, 0x00, 0x00, 0xc0, 0xc0, 0xc0, 0xc0, 0xc0, 0x00, 0x00, 0x00, 0x00, 0x00, 0x00, 0x00, 0x00, 
  0x00, 0x00, 0x00, 0x00, 0x00, 0x00, 0x00, 0xc0, 0xc0, 0xc0, 0xc0, 0xc0, 0x80, 0x00, 0x00, 0x00, 
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  0x00, 0x00, 0x00, 0x00, 0x00, 0x00, 0x00, 0x00, 0x00, 0x00, 0x00, 0x01, 0x01, 0x01, 0x01, 0x01
};

// 'urbanengine', 128x32px
const unsigned char UrbanEngineBitmap [] PROGMEM = {
  0x00, 0x00, 0x00, 0x00, 0xf8, 0xf8, 0xf8, 0xf8, 0xf8, 0xf8, 0xf8, 0x00, 0x00, 0x00, 0x00, 0x00, 
  0xfe, 0xfe, 0xfe, 0xfe, 0xfe, 0xfe, 0xfe, 0x00, 0x00, 0x00, 0x00, 0x00, 0xf8, 0xf8, 0xf8, 0xf8, 
  0xf8, 0xf8, 0xf8, 0x00, 0x00, 0x00, 0x00, 0x00, 0x00, 0x00, 0xf8, 0xf8, 0xf8, 0xf0, 0x00, 0x00, 
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  0x7f, 0x7f, 0x6e, 0x66, 0x66, 0x64, 0x00, 0x00, 0x00, 0x00, 0x00, 0x00, 0x00, 0x00, 0x00, 0x00
};


const unsigned char presentBitmap [] PROGMEM = {
  0x00, 0x00, 0x00, 0x00, 0xfc, 0xfc, 0xfc, 0xfc, 0x3c, 0x3c, 0x3c, 0x3c, 0x3c, 0x7c, 0xfc, 0xfc, 
  0xf8, 0xf8, 0xe0, 0x00, 0x00, 0x00, 0xfe, 0xfe, 0xfe, 0xfe, 0x1e, 0x1e, 0x1e, 0x1e, 0x1e, 0x1e, 
  0x3e, 0xfe, 0xfe, 0xfc, 0xfc, 0xf0, 0x00, 0x00, 0x00, 0xfc, 0xfc, 0xfc, 0xfc, 0xfc, 0x3c, 0x3c, 
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  0x00, 0x00, 0x3f, 0x7f, 0x7f, 0x7f, 0x7f, 0x00, 0x00, 0x00, 0x00, 0x00, 0x00, 0x00, 0x00, 0x00
};

const unsigned char hackBitmap [] PROGMEM = {
  0x00, 0x00, 0x00, 0x00, 0x00, 0x00, 0x00, 0x00, 0x00, 0x00, 0x00, 0x00, 0x00, 0x00, 0x00, 0x00, 
  0x00, 0x00, 0x00, 0x00, 0x00, 0x00, 0x00, 0x00, 0x00, 0x00, 0x00, 0x00, 0x00, 0x00, 0xf0, 0xf0, 
  0x00, 0x00, 0x00, 0x00, 0xf0, 0x00, 0x00, 0x00, 0x00, 0xe0, 0x70, 0xf0, 0x80, 0x00, 0x00, 0x00, 
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  0x00, 0x00, 0x00, 0x00, 0x00, 0x00, 0x00, 0x00, 0x00, 0x00, 0x00, 0x00, 0x00, 0x00, 0x00, 0x00
};


// 'makeithackin', 128x32px
const unsigned char MakeItHackinBitmap [] PROGMEM = { //MakeItHackin
  0x00, 0x00, 0x00, 0x00, 0x00, 0x00, 0x00, 0x00, 0x00, 0x00, 0x00, 0x00, 0x00, 0x00, 0x00, 0x00, 
  0x00, 0x00, 0x00, 0x00, 0x00, 0x00, 0x00, 0x00, 0x00, 0x00, 0x00, 0x00, 0x00, 0x00, 0xf0, 0xf8, 
  0x18, 0x18, 0x1c, 0x1c, 0x1c, 0x1c, 0x1c, 0x1c, 0x3e, 0x36, 0x22, 0x00, 0x00, 0x00, 0x00, 0x1c, 
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  0x00, 0x00, 0x00, 0x00, 0x00, 0x00, 0x00, 0x00, 0x00, 0x00, 0x00, 0x00, 0x00, 0x00, 0x00, 0x00
};


// 'latchbio', 128x32px
const unsigned char latchbioBitmap [] PROGMEM = {
  0x00, 0x00, 0x00, 0x00, 0x00, 0x00, 0x00, 0x00, 0x00, 0x00, 0x00, 0x00, 0x00, 0x00, 0x00, 0x00, 
  0x00, 0x00, 0x80, 0xc0, 0xe0, 0xc0, 0x80, 0x00, 0x00, 0x00, 0x80, 0xc0, 0xe0, 0xc0, 0x80, 0x00, 
  0x00, 0x00, 0x00, 0x00, 0x00, 0x00, 0x00, 0x00, 0x00, 0x00, 0x00, 0x00, 0x00, 0x00, 0x00, 0x00, 
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  0x00, 0x00, 0x00, 0x00, 0x00, 0x00, 0x00, 0x00, 0x00, 0x00, 0x00, 0x00, 0x00, 0x00, 0x00, 0x00
};

// MENU VARIABLES
byte NewMenuVar = 1;
const byte MenuCount = 3;
byte OldMenuVar = MenuCount + 1; 

// BUTTON VARIABLES
bool newState;
bool oldState = HIGH;

/*
AWARD TYPE:
0 - MAKE IT HACKIN
1 - HIGH SCHOOL FIRST PLACE
2 - HIGH SCHOOL SECOND PLACE
3 - PROFESSIONAL FIRST PLACE
4 - PROFESSIONAL SECOND PLACE
5 - PROFESSIONAL THIRD PLACE
6 - HUDSON ALPHA
7 - URBAN ENGINE
8 - HATCH
9 - LATCHBIO
*/

#define awardtype 8 //CHAGE THIS VALUE TO CHANGE THE AWARD TYPE

#define nightLightThreshold 30

#define neoPixelIntensity 64
#define nightLightBrightness 200
#define demodelay 2000
#define theaterChaseDelay 100

////////////////////////////////////////////////////////////////
//////////  SETUP LOOP
////////////////////////////////////////////////////////////////

void setup() {

  //Initialize pins
  pinMode(BUTTON_PIN, INPUT_PULLUP);
  pinMode(LIGHT_SENSOR_PIN, INPUT);
  pinMode(PIN,OUTPUT); //set pin output - this is not done internally by the library for Static version of library

  strip.setBrightness(neoPixelIntensity);
  
  //Start Neopixels
  //strip.begin(); //Static version does not use this.
  strip.show(); // Initialize all pixels to 'off'

  //Start Screen.  Some of these settings are to get the screen in the right orientation.
  OzOled.init();                 
  OzOled.clearDisplay(); 
  OzOled.setNormalDisplay();  
  OzOled.sendCommand(0xA1);
  OzOled.sendCommand(0xC8);
  OzOled.setHorizontalMode(); 
  OzOled.setBrightness(255);    

  //Draw the SPACE APPS logo
  OzOled.drawBitmap(HATCH2023Bitmap, 0, 0, 16, 8);

  delay(500);

  OzOled.drawBitmap(HudsonAlphaBitmap, 0, 0, 16, 8);

  delay(500);
    OzOled.drawBitmap(UrbanEngineBitmap, 0, 0, 16, 8);

  delay(500);
    OzOled.drawBitmap(latchbioBitmap, 0, 0, 16, 8);   

  delay(500);

  goToAwardMenu();

  delay(1000);
  
  OzOled.clearDisplay();  

  
}


////////////////////////////////////////////////////////////////
//////////  MAIN LOOP
////////////////////////////////////////////////////////////////

void loop() {

  // Check the button for activity
  DoButton();

  // Change the menu if button has been pushed
  MenuChange();

  //Reinitialize menu variables
  OldMenuVar = NewMenuVar;

}


////////////////////////////////////////////////////////////////
//////////  OTHER FUNCTIONS
////////////////////////////////////////////////////////////////

  
///////////////////////////////////////////////////////////////////////////////////////////////////////////////////

void goToAwardMenu(){
 
  OzOled.clearDisplay();

  if (awardtype == 0){
    //MakeItHackin
    OzOled.drawBitmap(MakeItHackinBitmap, 0, 0, 16, 8);
  }
  else if (awardtype == 1){
    //HIGH SCHOOL FIRST PLACE
   // OzOled.setCursorXY(0,0);   
    OzOled.printString("HIGH SCHOOL",3,0);  
   // OzOled.setCursorXY(0,2);  
    OzOled.printString("1st PLACE",4,2);  
              
  }
  else if (awardtype == 2){
    //HIGH SCHOOL SECOND PLACE
   // OzOled.setCursorXY(0,0);   
    OzOled.printString("HIGH SCHOOL",3,0);  
   // OzOled.setCursorXY(0,2);  
    OzOled.printString("2nd PLACE",4,2);  
  }
  else if (awardtype == 3){
    //PROFESSIONAL FIRST PLACE
   // OzOled.setCursorXY(0,0);   
    OzOled.printString("PROFESSIONAL",3,0);  
   // OzOled.setCursorXY(0,2);  
    OzOled.printString("1st PLACE",4,2);  
  }
  else if (awardtype == 4){
    //PROFESSIONAL SECOND PLACE
   // OzOled.setCursorXY(0,0);   
    OzOled.printString("PROFESSIONAL",3,0);  
   // OzOled.setCursorXY(0,2);  
    OzOled.printString("2nd PLACE",4,2);  
  }
  else if (awardtype == 5){
    //PROFESSIONAL THIRD PLACE
   // OzOled.setCursorXY(0,0);   
    OzOled.printString("PROFESSIONAL",3,0);  
   // OzOled.setCursorXY(0,2);  
    OzOled.printString("3rd PLACE",4,2);  
  }
  else if (awardtype == 6){
    //HUDSON ALPHA
    OzOled.drawBitmap(HudsonAlphaBitmap, 0, 0, 16, 8);
  }
  
  else if (awardtype == 7){
    //HATCH
    OzOled.drawBitmap(UrbanEngineBitmap, 0, 0, 16, 8);
  }
  else if (awardtype == 8){
    //HATCH
    OzOled.drawBitmap(HATCH2023Bitmap, 0, 0, 16, 8);
  }
  else if (awardtype == 9){
    //LatchBio
    OzOled.drawBitmap(latchbioBitmap, 0, 0, 16, 8);   
  }  
  else {
    //do nothing
    //PLACE HOLDER
  }
        
}

///////////////////////////////////////////////////////////////////////////////////////////////////////////////////

void DoButton(){

    // Get current button state.
  newState = digitalRead(BUTTON_PIN);

  // Check if state changed from high to low (button press).
  if (newState == LOW && oldState == HIGH) {
    // Short delay to debounce button.
    delay(20);
    // Check if button is still low after debounce.
    newState = digitalRead(BUTTON_PIN);
    if (newState == LOW) {
      NewMenuVar = OldMenuVar + 1;
      OzOled.clearDisplay();  
    }
    else {
      NewMenuVar = OldMenuVar;
    }
    if (NewMenuVar == MenuCount+1) {
       NewMenuVar = 1;
       }      
  }

  // Set the last button state to the old state.
  oldState = newState;

}

///////////////////////////////////////////////////////////////////////////////////////////////////////////////////

void MenuChange() {
  
         if (NewMenuVar == MenuCount+1) {
              NewMenuVar = 1;
             }
         
         if (NewMenuVar == 0) {
            NewMenuVar = MenuCount;
          }
      
        if (NewMenuVar == 1)
          {
             // OzOled.setCursorXY(0,0);   
              OzOled.printString("MAIN MENU",3,0);  
             // OzOled.setCursorXY(0,2);  
              OzOled.printString("PRESS BUTTON TO",1,2);  
             // OzOled.setCursorXY(0,3);  
              OzOled.printString("SEE FEATURES",2,3); 
              //rainbow(20);
          } 
          /*
        else if (NewMenuVar == 2)
          {
            showLightSensor();
          }  
          */   
          else if (NewMenuVar == 2)
          {
            nightLight();
          }  
        else if (NewMenuVar == 3)
          {
            //showLightSensor();
//            OzOled.setCursorXY(0,0);   
            OzOled.printString("STARTING", 1, 0);
            //OzOled.setCursorXY(0,1); 
            OzOled.printString("DEMO MODE...", 1,1);
            //OzOled.setCursorXY(0,2);   
            OzOled.printString("PRESS RESET", 1, 2);
            //OzOled.setCursorXY(0,3);   
            OzOled.printString("TO EXIT", 1, 3);
            delay(3000);
            StartDemoMode();
          }
                  
           else 
              {
               // OnOffBool1 = 0;
              }  

  //delay(100);        
}

///////////////////////////////////////////////////////////////////////////////////////////////////////////////////

void StartDemoMode(){
 // int demodelay = 2000;
 // int theaterChaseDelay = 100;
  //int neoPixelIntensity = 255; // (255 is max, 0 is min)

  OzOled.clearDisplay();

  OzOled.drawBitmap(HudsonAlphaBitmap, 0, 0, 16, 8);

  theaterChase(strip.Color(0, 0, neoPixelIntensity), theaterChaseDelay); // blue
  colorWipe(strip.Color(0, 0, 0), 0);    // Black/off

  OzOled.drawBitmap(UrbanEngineBitmap, 0, 0, 16, 8);

  theaterChase(strip.Color(0, neoPixelIntensity, 0), theaterChaseDelay); // blue
  colorWipe(strip.Color(0, 0, 0), 0);    // Black/off

  OzOled.drawBitmap(latchbioBitmap, 0, 0, 16, 8);

  theaterChase(strip.Color(neoPixelIntensity, 0, 0), theaterChaseDelay); // blue
  colorWipe(strip.Color(0, 0, 0), 0);    // Black/off

  //OzOled.clearDisplay();
  //OzOled.setCursorXY(0,1);   
  //OzOled.printString("    PRESENT");
  OzOled.drawBitmap(presentBitmap, 0, 0, 16, 8);
  //OzOled.drawBitmap(hackBitmap, 0, 0, 16, 8);  
            
  theaterChase(strip.Color(neoPixelIntensity, neoPixelIntensity, neoPixelIntensity), theaterChaseDelay); // white
  colorWipe(strip.Color(0, 0, 0), 0);    // Black/off

  OzOled.drawBitmap(HATCH2023Bitmap, 0, 0, 16, 8);

  theaterChase(strip.Color(0, 0, neoPixelIntensity), theaterChaseDelay); // Blue
  colorWipe(strip.Color(0, 0, 0), 0);    // Black/off

  //OzOled.clearDisplay();
  //OzOled.setCursorXY(0,1);   
  //OzOled.printString("   HACK THIS ");
  //OzOled.setCursorXY(0,3);   
  //OzOled.printString("   TROPHY!!! ");
  //OzOled.drawBitmap(presentBitmap, 0, 0, 16, 8);
  OzOled.drawBitmap(hackBitmap, 0, 0, 16, 8);  
            
  theaterChase(strip.Color(neoPixelIntensity, neoPixelIntensity, neoPixelIntensity), theaterChaseDelay); // white
  colorWipe(strip.Color(0, 0, 0), 0);    // Black/off

  goToAwardMenu();

  rainbow(100);
  colorWipe(strip.Color(0, 0, 0), 0);    // Black/off

//  DisplayLightSensorForDemo();

  OzOled.clearDisplay();

  for (int i=0; i < 100; i++){
    showLightSensor();
  }

  //OzOled.clearDisplay();
  //OzOled.setCursorXY(0,1);   
  //OzOled.printString("   HACK THIS ");
  //OzOled.setCursorXY(0,3);   
  //OzOled.printString("   TROPHY!!! ");
  //OzOled.drawBitmap(presentBitmap, 0, 0, 16, 8);
  OzOled.drawBitmap(hackBitmap, 0, 0, 16, 8);  

  rainbowCycle(20); //20
  colorWipe(strip.Color(0, 0, 0), 0);    // Black/off

  theaterChaseRainbow(50); //50
  colorWipe(strip.Color(0, 0, 0), 0);    // Black/off

  //OnOffBool9 = 0;
}

///////////////////////////////////////////////////////////////////////////////////////////////////////////////////
/*
void DisplayLightSensorForDemo(){
  OzOled.clearDisplay();
  for (int i=0; i < 100; i++){
    lightSensorValue = analogRead(LIGHT_SENSOR_PIN);
    //map(value, fromLow, fromHigh, toLow, toHigh)
    lightSensorValue = map(lightSensorValue, 880, 1000, 0, 100);
    
   // OzOled.setCursorXY(0,0);   
    OzOled.printString("LIGHT SENSOR",0,0);  
    OzOled.printString("VALUE",0,1.2);  
   //OzOled.setCursorXY(0,2);  
    OzOled.printNumber(long(lightSensorValue), 0, 3); 
    OzOled.printString("    ");
  }
}
*/
///////////////////////////////////////////////////////////////////////////////////////////////////////////////////

void showLightSensor(){
  lightSensorValue = analogRead(LIGHT_SENSOR_PIN);
  lightSensorValue = map(lightSensorValue, 880, 1000, 0, 100);
    
//  OzOled.setCursorXY(0,0);   
  OzOled.printString("LIGHT SENSOR",0,0);  
  OzOled.printString("VALUE",0,1.2);  
 //OzOled.setCursorXY(0,2);  
  OzOled.printNumber(long(lightSensorValue), 0, 3); 
  OzOled.printString("    "); 
}

///////////////////////////////////////////////////////////////////////////////////////////////////////////////////

void nightLight(){
  lightSensorValue = analogRead(LIGHT_SENSOR_PIN);
  lightSensorValue = map(lightSensorValue, 880, 1000, 0, 100);
    
//  OzOled.setCursorXY(0,0);   
  OzOled.printString("NIGHT LIGHT",0,0);  
  OzOled.printString("THRESHOLD:",0,1.2);  
  OzOled.printNumber(long(nightLightThreshold),12,1.2);
 //OzOled.setCursorXY(0,2);  
  OzOled.printNumber(long(lightSensorValue), 0, 3); 
  OzOled.printString("    "); 

  if (lightSensorValue < nightLightThreshold){
    colorWipe(strip.Color(nightLightBrightness, nightLightBrightness, nightLightBrightness), 0);
  }
  else{
    colorWipe(strip.Color(0, 0, 0), 0);    // Black/off
  }
    
}

///////////////////////////////////////////////////////////////////////////////////////////////////////////////////

// Fill the dots one after the other with a color
void colorWipe(uint32_t c, uint8_t wait) {
  for(uint16_t i=0; i<strip.numPixels(); i++) {
    strip.setPixelColor(i, c);
    strip.show();
    delay(wait);
  }
}

///////////////////////////////////////////////////////////////////////////////////////////////////////////////////

void rainbow(uint8_t wait) {
  uint16_t i, j;

  for(j=0; j<256; j++) {
    for(i=0; i<strip.numPixels(); i++) {
      strip.setPixelColor(i, Wheel((i+j) & 255));
    }
    strip.show();
    delay(wait);
  }
}

///////////////////////////////////////////////////////////////////////////////////////////////////////////////////

// Slightly different, this makes the rainbow equally distributed throughout
void rainbowCycle(uint8_t wait) {
  uint16_t i, j;

  for(j=0; j<256*5; j++) { // 5 cycles of all colors on wheel
    for(i=0; i< strip.numPixels(); i++) {
      strip.setPixelColor(i, Wheel(((i * 256 / strip.numPixels()) + j) & 255));
    }
    strip.show();
    delay(wait);
  }
}

///////////////////////////////////////////////////////////////////////////////////////////////////////////////////

//Theatre-style crawling lights.
void theaterChase(uint32_t c, uint8_t wait) {
  for (int j=0; j<10; j++) {  //do 10 cycles of chasing
    for (int q=0; q < 3; q++) {
      for (int i=0; i < strip.numPixels(); i=i+3) {
        strip.setPixelColor(i+q, c);    //turn every third pixel on
      }
      strip.show();

      delay(wait);

      for (int i=0; i < strip.numPixels(); i=i+3) {
        strip.setPixelColor(i+q, 0);        //turn every third pixel off
      }
    }
  }
}

///////////////////////////////////////////////////////////////////////////////////////////////////////////////////

//Theatre-style crawling lights with rainbow effect
void theaterChaseRainbow(uint8_t wait) {
  for (int j=0; j < 256; j++) {     // cycle all 256 colors in the wheel
    for (int q=0; q < 3; q++) {
      for (int i=0; i < strip.numPixels(); i=i+3) {
        strip.setPixelColor(i+q, Wheel( (i+j) % 255));    //turn every third pixel on
      }
      strip.show();

      delay(wait);

      for (int i=0; i < strip.numPixels(); i=i+3) {
        strip.setPixelColor(i+q, 0);        //turn every third pixel off
      }
    }
  }
}

///////////////////////////////////////////////////////////////////////////////////////////////////////////////////


// Input a value 0 to 255 to get a color value.
// The colours are a transition r - g - b - back to r.
uint32_t Wheel(byte WheelPos) {
  WheelPos = 255 - WheelPos;
  if(WheelPos < 85) {
    return strip.Color(255 - WheelPos * 3, 0, WheelPos * 3);
  }
  if(WheelPos < 170) {
    WheelPos -= 85;
    return strip.Color(0, WheelPos * 3, 255 - WheelPos * 3);
  }
  WheelPos -= 170;
  return strip.Color(WheelPos * 3, 255 - WheelPos * 3, 0);
}

///////////////////////////////////////////////////////////////////////////////////////////////////////////////////
///////////////////////////////////////////////////////////////////////////////////////////////////////////////////
